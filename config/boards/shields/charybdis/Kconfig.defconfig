## config/boards/shields/charybdis/Kconfig.defconfig
```kconfig
if SHIELD_CHARYBDIS_LEFT

config ZMK_KEYBOARD_NAME
	default "Charybdis"

config ZMK_SPLIT_ROLE_CENTRAL
	default y

endif

if SHIELD_CHARYBDIS_RIGHT

config ZMK_KEYBOARD_NAME
	default "Charybdis_R"

endif

if SHIELD_CHARYBDIS_LEFT || SHIELD_CHARYBDIS_RIGHT

config ZMK_SPLIT
	default y

endif
```

## config/boards/shields/flhp/Kconfig.defconfig
```kconfig
# Copyright (c) 2020 The ZMK Contributors
# SPDX-License-Identifier: MIT

if SHIELD_FLHP

config ZMK_KEYBOARD_NAME
    default "FLHP"

endif
```

## config/boards/shields/flhp/Kconfig.shield
```kconfig
# Copyright (c) 2020 The ZMK Contributors
# SPDX-License-Identifier: MIT

config SHIELD_FLHP
    def_bool $(shields_list_contains,flhp)
```

## config/boards/shields/gh/Kconfig.defconfig
```kconfig
# Copyright (c) 2020 The ZMK Contributors
# SPDX-License-Identifier: MIT

if SHIELD_GH

config ZMK_KEYBOARD_NAME
	default "Guitar Hero ZMK"

endif
```

## config/boards/shields/gh/Kconfig.shield
```kconfig
# Copyright (c) 2020 The ZMK Contributors
# SPDX-License-Identifier: MIT

config SHIELD_GH
	def_bool $(shields_list_contains,gh)
```

## config/boards/shields/gh5/Kconfig.defconfig
```kconfig
# Copyright (c) 2020 The ZMK Contributors
# SPDX-License-Identifier: MIT

if SHIELD_GH5

config ZMK_KEYBOARD_NAME
	default "Guitar Hero 5"

endif
```

## config/boards/shields/gh5/Kconfig.shield
```kconfig
# Copyright (c) 2020 The ZMK Contributors
# SPDX-License-Identifier: MIT

config SHIELD_GH5
	def_bool $(shields_list_contains,gh5)
```

## config/boards/shields/ghfb/Kconfig.defconfig
```kconfig
# Copyright (c) 2020 The ZMK Contributors
# SPDX-License-Identifier: MIT

if SHIELD_GHFB

config ZMK_KEYBOARD_NAME
	default "Guitar Hero Toy"

endif
```

## config/boards/shields/ghfb/Kconfig.shield
```kconfig
# Copyright (c) 2020 The ZMK Contributors
# SPDX-License-Identifier: MIT

config SHIELD_GHFB
	def_bool $(shields_list_contains,ghfb)
```
